## config/boards/shields/kozakura52/Kconfig.defconfig
```kconfig
if SHIELD_KOZAKURA52_L

config ZMK_KEYBOARD_NAME
    default "kozakura52_L"

config ZMK_SPLIT
    default y

config ZMK_SPLIT_ROLE_CENTRAL
    default y

endif

if SHIELD_KOZAKURA52_R

config ZMK_KEYBOARD_NAME
    default "kozakura52_R"

config ZMK_SPLIT
    default y

endif
```

## config/boards/shields/kozakura52/Kconfig.shield
```kconfig
# kozakura52.kconfig

config SHIELD_KOZAKURA52_R
    def_bool $(shields_list_contains,kozakura52_R)

config SHIELD_KOZAKURA52_L
    def_bool $(shields_list_contains,kozakura52_L)
```

## west.yml
```yaml
manifest:
  remotes:
    - name: zmkfirmware
      url-base: https://github.com/zmkfirmware
    - name: 96warabi-git
      url-base: https://github.com/96warabi-git

  projects:
    - name: zmk
      path: zmk
      remote: zmkfirmware
      revision: main
      import: app/west.yml

    - name: zmk-rgbled-widget
      path: modules/zmk-rgbled-widget
      remote: 96warabi-git
      revision: main

    - name: zmk-pmw3610-driver
      path: modules/zmk-pmw3610-driver
      remote: 96warabi-git
      revision: main

    - name: zephyr
      path: zephyr
      remote: zmkfirmware
      revision: v3.5.0+zmk-fixes
      import: true

  self:
    path: config
    
```
